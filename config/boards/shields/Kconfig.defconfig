## config/boards/shields/Kconfig.defconfig
```kconfig
if SHIELD_COPYKEYBOARD_LEFT

config ZMK_KEYBOARD_NAME
    default "COPYKEYBOARD"

config ZMK_SPLIT_ROLE_CENTRAL
    default y

endif

if SHIELD_COPYKEYBOARD_LEFT || SHIELD_COPYKEYBOARD_RIGHT

config ZMK_SPLIT
    default y

endif
```

## config/boards/shields/Kconfig.shield
```kconfig
config SHIELD_COPYKEYBOARD_LEFT
    def_bool $(shields_list_contains,COPYKEYBOARD_left)

config SHIELD_CALDERA_RIGHT
    def_bool $(shields_list_contains,COPYKEYBOARD_right)
```
